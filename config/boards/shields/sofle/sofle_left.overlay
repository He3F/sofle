#include "sofle.dtsi"

&default_transform { // The matrix transform for this board is 6 columns over because the left half is 6 columns wide according to the matrix.
    col-offset = <5>;
};

&kscan0 {
    col-gpios
        = <&gpio0 31 (GPIO_ACTIVE_HIGH | GPIO_PULL_DOWN)>,
          <&gpio0 2 (GPIO_ACTIVE_HIGH | GPIO_PULL_DOWN)>,
          <&gpio1 13 (GPIO_ACTIVE_HIGH | GPIO_PULL_DOWN)>,
          <&gpio0 10 (GPIO_ACTIVE_HIGH | GPIO_PULL_DOWN)>,
          <&gpio0 17 (GPIO_ACTIVE_HIGH | GPIO_PULL_DOWN)>,
          <&gpio0 22 (GPIO_ACTIVE_HIGH | GPIO_PULL_DOWN)>,
          <&gpio1 0 (GPIO_ACTIVE_HIGH | GPIO_PULL_DOWN)>;
};

&right_encoder {
    status = "okay";
};
